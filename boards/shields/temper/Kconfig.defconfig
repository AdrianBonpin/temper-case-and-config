## boards/shields/temper/Kconfig.defconfig
```kconfig
if SHIELD_TEMPER_LEFT

config ZMK_KEYBOARD_NAME
    default "RanTemper"

config ZMK_SPLIT_ROLE_CENTRAL
    default y

endif

if SHIELD_TEMPER_LEFT || SHIELD_TEMPER_RIGHT

config ZMK_SPLIT
    default y

endif

if ZMK_DISPLAY

config I2C
    default y

config SSD1306
    default y

endif # ZMK_DISPLAY
```
